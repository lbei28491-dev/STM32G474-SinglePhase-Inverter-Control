#include "ssd1306.h"

/* SSD1306 命令 */
#define SSD1306_SET_CONTRAST        0x81
#define SSD1306_DISPLAY_ON          0xAF
#define SSD1306_DISPLAY_OFF         0xAE
#define SSD1306_NORMAL_DISPLAY      0xA6
#define SSD1306_INVERT_DISPLAY      0xA7
#define SSD1306_SET_MUX_RATIO       0xA8
#define SSD1306_SET_DISPLAY_OFFSET   0xD3
#define SSD1306_SET_DISPLAY_START_LINE  0x40
#define SSD1306_SET_SEG_REMAP       0xA1
#define SSD1306_SET_COM_SCAN_DIR    0xC8
#define SSD1306_SET_COM_PINS        0xDA
#define SSD1306_SET_PAGE_ADDR       0xB0
#define SSD1306_SET_COL_ADDR_LOW    0x00
#define SSD1306_SET_COL_ADDR_HIGH   0x10
#define SSD1306_SET_CLK_DIV         0xD5
#define SSD1306_SET_PRECHARGE       0xD9
#define SSD1306_SET_VCOM_DESEL      0xDB
#define SSD1306_CHARGE_PUMP         0x8D

/* I2C 控制字节 */
#define SSD1306_I2C_CMD   0x00
#define SSD1306_I2C_DATA  0x40

static uint8_t ssd1306_buf[SSD1306_BUF_SIZE];
static uint8_t cursor_x = 0, cursor_y = 0;

extern I2C_HandleTypeDef SSD1306_I2C_PORT;

static void ssd1306_WriteCmd(uint8_t cmd)
{
    uint8_t b[2] = { SSD1306_I2C_CMD, cmd };
    HAL_I2C_Master_Transmit(&SSD1306_I2C_PORT, SSD1306_I2C_ADDR, b, 2, 10);
}

static void ssd1306_WriteData(uint8_t *p, uint16_t n)
{
    static uint8_t tmp[SSD1306_BUF_SIZE + 1];
    tmp[0] = SSD1306_I2C_DATA;
    for (uint16_t i = 0; i < n; i++) tmp[i + 1] = p[i];
    HAL_I2C_Master_Transmit(&SSD1306_I2C_PORT, SSD1306_I2C_ADDR, tmp, n + 1, 50);
}

/* 标准 5x7 ASCII 字体（从空格 0x20 开始） */
static const uint8_t font5x7[][5] = {
    {0x00,0x00,0x00,0x00,0x00}, /* ' ' */
    {0x00,0x00,0x5F,0x00,0x00}, /* '!' */
    {0x00,0x07,0x00,0x07,0x00}, /* '"' */
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    {0x08,0x2A,0x1C,0x2A,0x08}, /* '~' */
};

void ssd1306_Init(void)
{
    HAL_Delay(50);  /* 上电等待 */

    ssd1306_WriteCmd(SSD1306_DISPLAY_OFF);
    ssd1306_WriteCmd(SSD1306_SET_MUX_RATIO);    ssd1306_WriteCmd(0x3F);
    ssd1306_WriteCmd(SSD1306_SET_DISPLAY_OFFSET); ssd1306_WriteCmd(0x00);
    ssd1306_WriteCmd(SSD1306_SET_DISPLAY_START_LINE);
    ssd1306_WriteCmd(SSD1306_SET_SEG_REMAP);
    ssd1306_WriteCmd(SSD1306_SET_COM_SCAN_DIR);
    ssd1306_WriteCmd(SSD1306_SET_COM_PINS);     ssd1306_WriteCmd(0x12);
    ssd1306_WriteCmd(SSD1306_SET_CONTRAST);     ssd1306_WriteCmd(0xCF);
    ssd1306_WriteCmd(SSD1306_SET_CLK_DIV);     ssd1306_WriteCmd(0x80);
    ssd1306_WriteCmd(SSD1306_SET_PRECHARGE);    ssd1306_WriteCmd(0xF1);
    ssd1306_WriteCmd(SSD1306_SET_VCOM_DESEL);  ssd1306_WriteCmd(0x40);
    ssd1306_WriteCmd(SSD1306_CHARGE_PUMP);      ssd1306_WriteCmd(0x14);
    ssd1306_WriteCmd(SSD1306_NORMAL_DISPLAY);
    ssd1306_WriteCmd(SSD1306_DISPLAY_ON);
}

void ssd1306_Fill(SSD1306_Color color)
{
    uint8_t v = (color == White) ? 0xFF : 0x00;
    for (uint16_t i = 0; i < SSD1306_BUF_SIZE; i++) ssd1306_buf[i] = v;
}

void ssd1306_UpdateScreen(void)
{
    for (uint8_t page = 0; page < 8; page++) {
        ssd1306_WriteCmd(SSD1306_SET_PAGE_ADDR | page);
        ssd1306_WriteCmd(SSD1306_SET_COL_ADDR_LOW);
        ssd1306_WriteCmd(SSD1306_SET_COL_ADDR_HIGH);
        ssd1306_WriteData(&ssd1306_buf[page * SSD1306_WIDTH], SSD1306_WIDTH);
    }
}

void ssd1306_SetCursor(uint8_t x, uint8_t y)
{
    if (x >= SSD1306_WIDTH)  x = SSD1306_WIDTH  - 1;
    if (y >= SSD1306_HEIGHT) y = SSD1306_HEIGHT - 1;
    cursor_x = x;
    cursor_y = y;
}

char ssd1306_WriteChar(char ch, SSD1306_Color color)
{
    if (ch < ' ' || ch > '~') ch = ' ';
    const uint8_t *glyph = font5x7[ch - ' '];

    for (uint8_t i = 0; i < 5; i++) {
        uint8_t col_x = cursor_x + i;
        if (col_x >= SSD1306_WIDTH) break;

        uint8_t col = (color == White) ? glyph[i] : (~glyph[i] & 0x7F);
        uint8_t page = cursor_y / 8;
        uint8_t bit_in_page = cursor_y % 8;

        if (color == White) {
            ssd1306_buf[page * SSD1306_WIDTH + col_x] |=  (col << bit_in_page);
            if (bit_in_page && (page + 1) < 8)
                ssd1306_buf[(page + 1) * SSD1306_WIDTH + col_x] |= (col >> (8 - bit_in_page));
        } else {
            ssd1306_buf[page * SSD1306_WIDTH + col_x] &= ~(0x7F << bit_in_page);
            if (bit_in_page && (page + 1) < 8)
                ssd1306_buf[(page + 1) * SSD1306_WIDTH + col_x] &= ~(0x7F >> (8 - bit_in_page));
        }
    }
    cursor_x += (SSD1306_FONT_WIDTH + 1);
    return ch;
}

void ssd1306_WriteString(const char *str, SSD1306_Color color)
{
    while (*str) ssd1306_WriteChar(*str++, color);
}
